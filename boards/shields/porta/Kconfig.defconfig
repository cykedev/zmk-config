## boards/shields/porta/Kconfig.defconfig
```kconfig
# Copyright (c) 2025 Christian Eiden
# SPDX-License-Identifier: MIT
 
 
if SHIELD_PORTA_LEFT

config ZMK_KEYBOARD_NAME
	default "porta left"

endif

if SHIELD_PORTA_RIGHT

config ZMK_KEYBOARD_NAME
	default "porta"

config ZMK_SPLIT_BLE_ROLE_CENTRAL
	default y

endif

if SHIELD_PORTA_LEFT || SHIELD_PORTA_RIGHT

config ZMK_SPLIT
	default y
	
endif
```

## boards/shields/porta/Kconfig.shield
```kconfig
# Copyright (c) 2025 Christian Eiden
# SPDX-License-Identifier: MIT

config SHIELD_PORTA_LEFT
	def_bool $(shields_list_contains,porta_left)

config SHIELD_PORTA_RIGHT
	def_bool $(shields_list_contains,porta_right)
```

## boards/shields/scylla/Kconfig.defconfig
```kconfig
# Copyright (c) 2025 Christian Eiden
# SPDX-License-Identifier: MIT
 
 
if SHIELD_SCYLLA_LEFT

config ZMK_KEYBOARD_NAME
	default "Scylla Left"

endif

if SHIELD_SCYLLA_RIGHT

config ZMK_KEYBOARD_NAME
	default "Scylla MK2"

config ZMK_SPLIT_BLE_ROLE_CENTRAL
	default y

endif

if SHIELD_SCYLLA_LEFT || SHIELD_SCYLLA_RIGHT

config ZMK_SPLIT
	default y
	
endif
```

## boards/shields/scylla/Kconfig.shield
```kconfig
# Copyright (c) 2022 Christian Eiden
# SPDX-License-Identifier: MIT

config SHIELD_SCYLLA_LEFT
	def_bool $(shields_list_contains,scylla_left)

config SHIELD_SCYLLA_RIGHT
	def_bool $(shields_list_contains,scylla_right)
```
