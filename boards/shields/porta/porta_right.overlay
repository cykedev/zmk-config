/*
 * Copyright (c) 2025 Christian Eiden
 *
 * SPDX-License-Identifier: MIT
 */
 
#include "porta.dtsi"

&keymap_transform0 {
	col-offset = <6>;
};

&kscan0 {
	col-gpios
		= <&pro_micro 10 (GPIO_ACTIVE_HIGH)>
		, <&pro_micro 16 (GPIO_ACTIVE_HIGH)>
		, <&pro_micro 14 (GPIO_ACTIVE_HIGH)>
		, <&pro_micro 15  (GPIO_ACTIVE_HIGH)>
		, <&pro_micro 18  (GPIO_ACTIVE_HIGH)>
		, <&pro_micro 19  (GPIO_ACTIVE_HIGH)>
		;
};
